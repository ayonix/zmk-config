#include <input/processors.dtsi>
#include <dt-bindings/zmk/input_transform.h>

&trackball_listener {
    input-processors = <&zip_temp_layer 9 400>;

    scroll_mode {
        layers = <3>;
        input-processors = <&zip_xy_to_scroll_mapper
                            &zip_scroll_transform (INPUT_TRANSFORM_X_INVERT | INPUT_TRANSFORM_Y_INVERT)
                            &zip_scroll_scaler 1 32
                            &zip_temp_layer 9 400>;
    };

    snipe_mode {
        layers = <10>;
        input-processors = <&zip_xy_scaler 2 5 &zip_temp_layer 9 400>;
    };
};
